## boards/shields/dactyl_manuform/Kconfig.defconfig
```kconfig
config ZMK_KEYBOARD_NAME
    default "Dactyl Manuform"


config ZMK_USB
    default y

if SHIELD_DACTYL_MANUFORM_RIGHT
config ZMK_SPLIT_ROLE_CENTRAL
    default y

config ZMK_SPLIT_BLE_CENTRAL_PERIPHERALS
    default 1
endif

if SHIELD_DACTYL_MANUFORM_LEFT || SHIELD_DACTYL_MANUFORM_RIGHT

config ZMK_SPLIT
    default y

endif

if SHIELD_DACTYL_MANUFORM_LEFT

config ZMK_SPLIT_ROLE_CENTRAL
    default n

endif
```
