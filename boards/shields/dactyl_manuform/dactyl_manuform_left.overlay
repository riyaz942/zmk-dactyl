#include "dactyl_manuform.dtsi" // Notice that the main dtsi files are included in the overlay.

&kscan0 {
    col-gpios
        = <&gpio0 5 GPIO_ACTIVE_HIGH> // col1 in the schematic
        , <&gpio0 6 GPIO_ACTIVE_HIGH> // col2 in the schematic
        , <&gpio0 7 GPIO_ACTIVE_HIGH> // col3 in the schematic
        , <&gpio0 8 GPIO_ACTIVE_HIGH> // col4 in the schematic
        , <&gpio0 9 GPIO_ACTIVE_HIGH> // col5 in the schematic
        ;
};
